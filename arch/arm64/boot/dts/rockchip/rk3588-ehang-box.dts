// SPDX-License-Identifier: (GPL-2.0+ OR MIT)
/*
 * Copyright (c) 2021 Rockchip Electronics Co., Ltd.
 *
 */

/dts-v1/;

#include "rk3588-ehang-box.dtsi"
//#include "rk3588-evb7-imx415.dtsi"
#include "rk3588-linux.dtsi"

/ {
	model = "Rockchip RK3588 EHANG BOX Board";
	compatible = "rockchip,rk3588-ehang-box", "rockchip,rk3588";
};
